## components/ao_core/Kconfig.projbuild
```kconfig
menu "Active Object Memory Pool Configuration"

config AO_MPOOL_BLOCK_SIZE
    int "Tamaño de bloque del memory pool"
    default 8
    help
        Define el tamaño de cada bloque en bytes.
        Debe ser mayor o igual a sizeof(ao_evt_t).

config AO_MPOOL_BLOCK_COUNT
    int "Cantidad de bloques en el memory pool"
    default 32
    help
        Número total de bloques disponibles en el pool.

config AO_QUEUE_LEN
    int "Tamaño de cola por defecto para cada AO/FSM"
    default 8
    help
        Número máximo de eventos que pueden encolarse en un AO.

config AO_POST_TIMEOUT_MS
    int "Timeout por defecto (ms) en ao_post()"
    default 100
    help
        Tiempo máximo de espera para encolar un evento cuando la cola está llena.

endmenu
```

## components/mqtt_driver/Kconfig.projbuild
```kconfig
menu "MQTT Client Configuration"

    config BROKER_URL
        string "Broker URL"
        default "mqtt://192.168.160.1"
        help
            URL of the broker to connect to
    
    config BROKER_PORT
        int "Broker Port"
        default 1883
        help
            Port of the broker to connect to

    config BROKER_USERNAME
        string "Broker Username"
        default "dev"
        help
            Username for the MQTT broker, if required
    config BROKER_CLIENT_ID
        string "Broker Client ID"
        default "esp32_mqtt_client"
        help
            Client ID for the MQTT connection, if required
    config BROKER_PASSWORD
        string "Broker Password"
        default "dev12#45ice"
        help
            Password for the MQTT broker, if required
            
    config MQTT_RECONNECT_TIMEOUT_MS
        int "MQTT Reconnect Timeout (ms)"
        default 5000
        help
            Timeout in milliseconds for MQTT reconnection attempts
endmenu
```

## components/network_drivers/net_driver/Kconfig.projbuild
```kconfig
menu "Ethernet Configuration"

    config ETH_SPI_HOST
        int "SPI Host Number"
        range 0 2
        default 1
        help
            Set the SPI host used to communicate with the SPI Ethernet Controller.
    config ETH_SPI_SCLK_GPIO
        int "SPI SCLK GPIO number"
        default 6 
        help
            Set the GPIO number used by SPI SCLK.
    config ETH_SPI_MOSI_GPIO
        int "SPI MOSI GPIO number"
        default 7
        help
            Set the GPIO number used by SPI MOSI.
    config ETH_SPI_MISO_GPIO
        int "SPI MISO GPIO number"
        default 2
        help
            Set the GPIO number used by SPI MISO.
    config ETH_SPI_CLOCK_MHZ
        int "SPI clock speed (MHz)"
        range 5 80
        default 16
        help
            Set the clock speed (MHz) of SPI interface.
    config ETH_SPI_CS0_GPIO
        int "SPI CS0 GPIO number for SPI Ethernet module #1"
        default 5
        help
            Set the GPIO number used by SPI CS0, i.e. Chip Select associated with the first SPI Eth module).
    config ETH_SPI_INT0_GPIO
        int "Interrupt GPIO number SPI Ethernet module #1"
        default 4 
        help
            Set the GPIO number used by the first SPI Ethernet module interrupt line.
            Set -1 to use SPI Ethernet module in polling mode.
     config ETH_SPI_POLLING0_MS_VAL
        depends on ETH_SPI_INT0_GPIO < 0
        int "Polling period in msec of SPI Ethernet Module #1"
        default 10
        help
            Set SPI Ethernet module polling period.
    # Hidden variable to ensure that polling period option is visible only when interrupt is set disabled and
    # it is set to known value (0) when interrupt is enabled at the same time.
    config ETH_SPI_POLLING0_MS
        int
        default ETH_SPI_POLLING0_MS_VAL if ETH_SPI_POLLING0_MS_VAL > 0
        default 0
    config ETH_SPI_PHY_RST0_GPIO
        int "PHY Reset GPIO number of SPI Ethernet Module #1"
        default 3
        help
            Set the GPIO number used to reset PHY chip on the first SPI Ethernet module.
            Set to -1 to disable PHY chip hardware reset.
    config ETH_SPI_PHY_ADDR0
        int "PHY Address of SPI Ethernet Module #1"
        range 0 31
        default 1
        help
            Set the first SPI Ethernet module PHY address according your board schematic.

endmenu
```

## components/sntp_driver/Kconfig.projbuild
```kconfig
menu "SNTP Configuration"

    config SNTP_TIME_SERVER
        string "SNTP server name"
        default "192.168.160.1"
        help
            Hostname of the main SNTP server.
    config SNTP_RETRY_TIMEOUT_MS
        int "SNTP wait timeout (ms)"
        default 2000
    config SNTP_RETRY_COUNT
        int "SNTP max retry attempts"
        default 10
endmenu
```
